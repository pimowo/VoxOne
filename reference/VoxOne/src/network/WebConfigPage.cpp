#include "WebConfigPage.h"

namespace WebConfigPage {
const char* css() {
    return R"CSS(:root{color-scheme:dark;--bg:#101827;--surface:#1f2937;--surface-alt:#111827;--text:#e5e7eb;--strong:#fff;--muted:#9ca3af;--accent:#65d46e;--border:#374151;--ok:#14532d;--err:#7f1d1d}
*{box-sizing:border-box}body{margin:0;background:var(--bg);color:var(--text);font:15px/1.4 system-ui,sans-serif}
.page,.nav{width:min(720px,calc(100% - 20px));margin:auto}header{padding:12px 0 5px}h1{font-size:22px;margin:0;color:var(--strong)}h2{font-size:16px;margin:0 0 9px;color:var(--strong)}p{margin:5px 0}.muted,.key,footer{color:var(--muted)}
.nav{display:flex;gap:4px;flex-wrap:wrap;padding:4px 0}.nav a{flex:1 1 auto;text-align:center;color:var(--text);text-decoration:none;padding:7px;border:1px solid var(--border);border-radius:8px;background:var(--surface)}.nav a.active{background:var(--ok);border-color:var(--ok);font-weight:700}
main{padding:4px 0 12px}.grid{display:grid;grid-template-columns:repeat(auto-fit,minmax(260px,1fr));gap:8px}.card{background:var(--surface);border:1px solid var(--border);border-radius:12px;padding:12px;margin:8px 0;min-width:0}.grid .card{margin:0}
.row{display:grid;grid-template-columns:minmax(118px,36%) minmax(0,1fr);gap:8px;padding:6px 0;border-top:1px solid var(--border);align-items:center}.row:first-of-type{border:0}.key{font-size:13px}.value{overflow-wrap:anywhere;color:var(--strong)}
input,select,button{font:inherit}input,select{width:100%;min-height:36px;padding:6px 8px;background:var(--surface-alt);color:var(--strong);border:1px solid #4b5563;border-radius:7px}button{min-height:36px;padding:7px 12px;background:var(--border);color:var(--strong);border:1px solid #4b5563;border-radius:8px;font-weight:700;cursor:pointer}button.primary{background:var(--accent);border-color:var(--accent);color:#102018}button.danger{background:var(--err);border-color:var(--err)}button:disabled{opacity:.5;cursor:wait}button:focus-visible,input:focus-visible,select:focus-visible,a:focus-visible{outline:2px solid var(--accent);outline-offset:2px}
.actions{display:flex;gap:6px;flex-wrap:wrap;margin:8px 0}.actions button{flex:1 1 110px}.wifi-profile-toggle{width:100%;display:flex;align-items:center;gap:8px;text-align:left;background:var(--surface-alt);border-color:var(--border)}.wifi-profile-ssid{margin-left:auto;overflow:hidden;text-overflow:ellipsis;white-space:nowrap;color:var(--muted);font-weight:400}.wifi-profile-body{padding-top:6px}.tag{display:inline-block;border-radius:999px;padding:2px 8px;background:var(--border);font-size:12px;font-weight:700}.tag.ok,.notice.ok{background:var(--ok);color:#bbf7d0}.tag.err,.notice.err{background:var(--err);color:#fecaca}.notice{border-radius:9px;padding:9px 11px;margin:8px 0}.hint{color:var(--muted);font-size:12px}.planned{color:#facc15;font-size:12px}.section-title{font-size:12px;color:var(--muted);margin:12px 0 0}footer{padding:10px 0;border-top:1px solid var(--border);font-size:12px;text-align:center}[hidden]{display:none!important}
.station-item h2{display:flex;gap:7px;align-items:center}.station-url{overflow-wrap:anywhere}.station-form .row{grid-template-columns:minmax(100px,28%) minmax(0,1fr)}
@media(max-width:460px){.page,.nav{width:calc(100% - 16px)}.grid{grid-template-columns:1fr}.row{grid-template-columns:minmax(100px,36%) minmax(0,1fr);gap:6px}.card{padding:11px}}
)CSS";
}

const char* html() {
    return R"HTML(<!doctype html><html lang="pl"><head><meta charset="utf-8"><meta name="viewport" content="width=device-width,initial-scale=1"><link rel="stylesheet" href="/assets/voxone.css"><title>VoxOne</title></head><body>
<header class="page"><h1>VoxOne</h1><p class="muted">Lokalny panel konfiguracji <span class="tag ok">GOTOWY</span></p></header>
<nav class="nav" aria-label="Nawigacja"><a href="#status" data-tab="status">Status</a><a href="#settings" data-tab="settings">Ustawienia</a><a href="#system" data-tab="system">System</a></nav>
<main class="page">
<section id="stations" hidden><p class="section-title">Stacje radiowe</p>
<div class="card station-form"><h2 id="stationFormTitle">Dodaj stacje</h2><form id="stationForm">
<input type="hidden" id="stationId" value="">
<div class="row"><label class="key" for="stationName">Nazwa</label><span class="value"><input id="stationName" maxlength="48" required></span></div>
<div class="row"><label class="key" for="stationUrl">URL HTTP/HTTPS</label><span class="value"><input id="stationUrl" maxlength="192" placeholder="https://..." required></span></div>
<div class="row"><label class="key" for="stationTrim">Volume Trim</label><span class="value"><input id="stationTrim" type="number" min="-20" max="20" step="1" value="0" required><small class="hint">Pole jest zapisane; korekta gain nie jest jeszcze wykonywana runtime.</small></span></div>
<div class="actions"><button class="primary" type="submit">ZAPISZ STACJE</button><button id="stationCancel" type="button" hidden>ANULUJ EDYCJE</button></div>
</form></div>
<div id="stationList"></div><p id="stationEmpty" class="card muted" hidden>Brak stacji. Dodaj pierwsza stacje powyzej.</p>
</section>
<section id="status"><p class="section-title">Status</p><div class="grid">
<div class="card"><h2>Audio</h2><p class="hint">Zmiany konfiguracji audio zaczną działać po zapisie i restarcie. Radio może grać podczas korzystania z WWW.</p></div>
<div class="card"><h2>Sieć i system</h2><div class="row"><span class="key">Wi-Fi</span><strong class="value" data-status="wifi_status">-</strong></div><div class="row"><span class="key">IP</span><strong class="value" data-status="ip">-</strong></div><div class="row"><span class="key">Hostname</span><strong class="value" data-status="hostname">-</strong></div><div class="row"><span class="key">Profil aktywny</span><strong class="value" data-status="wifi_active_profile">-</strong></div><div class="row"><span class="key">Ostatnio używany</span><strong class="value" data-status="wifi_last_good_profile">-</strong></div><div class="row"><span class="key">Profile włączone</span><strong class="value" data-status="wifi_enabled_profiles">-</strong></div><div class="row"><span class="key">RSSI</span><strong class="value" data-status="wifi_rssi">-</strong></div><div class="row"><span class="key">Uptime</span><strong class="value" data-status="uptime_s">-</strong></div><div class="row"><span class="key">Heap</span><strong class="value" data-status="free_heap">-</strong></div></div></div>
</section>
<section id="settings" hidden><p class="section-title">Ustawienia trwałe · obowiązują po restarcie</p><form id="configForm"><div id="configFields"></div><div class="actions"><button class="primary" type="submit">ZAPISZ</button></div></form></section>
<section id="system" hidden><p class="section-title">System</p><div class="card"><h2>Informacje</h2><div class="row"><span class="key">Firmware</span><strong class="value" data-status="fw">-</strong></div><div class="row"><span class="key">Schema</span><strong class="value" data-status="config_schema">-</strong></div><div class="row"><span class="key">Build</span><strong class="value" data-status="build">-</strong></div><div class="row"><span class="key">Powód restartu</span><strong class="value" data-status="reset_reason">-</strong></div></div><div class="card"><h2>Administracja</h2><div class="actions"><button type="button" id="reboot">Restart</button><button type="button" id="clearWifi">Usuń Wi-Fi</button><button type="button" class="danger" id="reset">Przywróć ustawienia</button></div><p class="hint">Reset zapisuje domyślne ustawienia i uruchamia VoxOne ponownie.</p></div></section>
<p id="notice" class="notice" role="status" hidden></p>
</main><footer class="page">VoxOne · lokalny interfejs WWW</footer>
<script>
(() => {
const $=s=>document.querySelector(s),all=s=>document.querySelectorAll(s),note=$('#notice');
const show=(ok,msg)=>{note.hidden=false;note.className='notice '+(ok?'ok':'err');note.textContent=msg};
const boolOpts=[['0','OFF'],['1','ON']];
const groups=[
['Ogólne','',[
['device.name','Nazwa urządzenia','text',48]]],
['Funkcje','',[
['features.bluetoothEnabled','Zewnętrzny VoxOneBT','bool'],['features.radioEnabled','Radio','bool'],['features.displayEnabled','Display','bool'],['features.encoderEnabled','Encoder','bool'],['features.mqttEnabled','MQTT','bool']]],
['Audio','',[
['audio.volume','Głośność','number','0:100'],['audio.maxVolume','Maksymalna głośność logiczna','number','1:100'],['audio.outputType','Typ wyjścia','select',[['0','PCM5102A'],['1','MAX98357A']]],['audio.i2sBclk','I2S BCLK','number','0:39'],['audio.i2sLrclk','I2S LRCLK','number','0:39'],['audio.i2sDout','I2S DOUT','number','0:39']]],
['Radio','features.radioEnabled',[
['radio.defaultStation','Stacja domyślna','number','0:9999']]],
['Display','features.displayEnabled',[
['display.type','Typ display','select',[['0','ST7789'],['1','SSD1306']]]]],
['Piny ST7789','display.type=0',[
['display.st7789.sck','SCK','number','0:39'],['display.st7789.mosi','MOSI','number','0:39'],['display.st7789.cs','CS','number','0:39'],['display.st7789.dc','DC','number','0:39'],['display.st7789.rst','RST (-1 = brak)','number','-1:39']]],
['Encoder','features.encoderEnabled',[
['encoder.pinA','Pin A','number','0:39'],['encoder.pinB','Pin B','number','0:39'],['encoder.pinButton','Przycisk','number','0:39'],['encoder.direction','Kierunek','select',[['0','NORMAL'],['1','REVERSED']]],['encoder.volumeStep','Krok głośności','number','1:10']]],
['UI / nawigacja','',[[
'ui.navigationTimeoutMs','Timeout nawigacji (ms)','number','1000:30000',null,null,'Dotyczy ekranów BT NAV i przyszłej listy stacji.']]],
['MQTT','features.mqttEnabled',[
['mqtt.host','Host','text',128],['mqtt.port','Port','number','1:65535'],['mqtt.username','Użytkownik','text',128],['mqtt.password','Hasło (puste = zachowaj)','password',128],['mqtt.rootTopic','Root topic','text',128,null,null,'Opcjonalny; puste = auto voxone-XXXXXX.']]],
['Sieć','',[
['network.ntpEnabled','NTP','bool']]]
];
groups.splice(3,1);
for(let i=0;i<5;i++){const p='wifi.networks.'+i+'.';groups.push(['Wi-Fi profil '+(i+1),'',[
[p+'enabled','Włączony','bool'],[p+'ssid','SSID','text',32],[p+'password','Hasło (puste = zachowaj)','password',64],[p+'clearPassword','Usuń zapisane hasło','bool'],[p+'priority','Priorytet','number','0:100']],'wifi']);}
let csrf='',configPromise=null,statusReady=false,statusInFlight=false,restartWaitActive=false;
function inputFor(f){const [key,label,type,meta,planned,condition,hint]=f,row=document.createElement('div'),lab=document.createElement('label');row.className='row';row.dataset.condition=condition||'';lab.className='key';lab.textContent=label;let input;if(type==='bool'||type==='select'){input=document.createElement('select');(type==='bool'?boolOpts:meta).forEach(x=>{const opt=document.createElement('option');opt.value=x[0];opt.textContent=x[1];input.append(opt)})}else{input=document.createElement('input');input.type=type;if(type==='number'){const lim=meta.split(':');input.min=lim[0];input.max=lim[1];input.step='1'}else input.maxLength=meta}input.name=key;input.id=key.replaceAll('.','_');if(key==='mqtt.rootTopic')input.placeholder='voxone-XXXXXX';lab.htmlFor=input.id;const box=document.createElement('span');box.className='value';box.append(input);if(planned==='planned'||(type==='bool'&&meta==='planned')){const p=document.createElement('small');p.className='planned';p.textContent='Obsługa runtime planowana';box.append(p)}if(hint){const p=document.createElement('small');p.className='hint';p.textContent=hint;box.append(p)}row.append(lab,box);return row}
for(const [title,condition,fields,kind] of groups){const section=document.createElement('section');section.className='card';section.dataset.condition=condition;if(kind==='wifi'){const toggle=document.createElement('button'),heading=document.createElement('span'),ssid=document.createElement('span'),symbol=document.createElement('span'),body=document.createElement('div');toggle.type='button';toggle.className='wifi-profile-toggle';toggle.setAttribute('aria-expanded','false');heading.textContent=title;ssid.className='wifi-profile-ssid';symbol.textContent='>';toggle.appendChild(heading);toggle.appendChild(ssid);toggle.appendChild(symbol);body.className='wifi-profile-body';body.hidden=true;fields.forEach(f=>body.appendChild(inputFor(f)));section.appendChild(toggle);section.appendChild(body);const update=()=>{const input=body.querySelector('input[name$=".ssid"]');ssid.textContent=input&&input.value?input.value:''};const setOpen=open=>{body.hidden=!open;toggle.setAttribute('aria-expanded',String(open));symbol.textContent=open?'v':'>'};toggle.onclick=()=>setOpen(body.hidden);body.addEventListener('input',update);update()}else{const h=document.createElement('h2');h.textContent=title;section.appendChild(h);fields.forEach(f=>section.appendChild(inputFor(f)))}$('#configFields').appendChild(section)}
const form=$('#configForm');
function visible(expr){if(!expr)return true;const [key,expected]=expr.split('='),input=form.elements.namedItem(key);return input&&(expected===undefined?input.value==='1':input.value===expected)}
function conditions(){all('#configFields [data-condition]').forEach(e=>{const condition=e.dataset.condition;e.hidden=!visible(condition)||(condition.startsWith('display.type=')&&!visible('features.displayEnabled'))})}
form.addEventListener('change',conditions);
function tab(){const current=['stations','settings','system'].includes(location.hash.slice(1))?location.hash.slice(1):'status';['status','stations','settings','system'].forEach(t=>{$('#'+t).hidden=t!==current;$('.nav [data-tab="'+t+'"]').classList.toggle('active',t===current)});note.hidden=true;if(current==='stations')loadStations()}
const stationTab=document.createElement('a');stationTab.href='#stations';stationTab.dataset.tab='stations';stationTab.textContent='Stacje';const nav=$('.nav');nav.insertBefore(stationTab,nav.children[1]);
const stationForm=$('#stationForm'),stationList=$('#stationList'),stationEmpty=$('#stationEmpty');
function clearStationForm(){stationForm.reset();$('#stationId').value='';$('#stationTrim').value='0';$('#stationFormTitle').textContent='Dodaj stacje';$('#stationCancel').hidden=true}
function stationBody(extra={}){return new URLSearchParams({_token:csrf,...extra})}
async function ensureCsrf(){if(csrf)return;if(!configPromise)configPromise=loadConfig();await configPromise;if(!csrf)throw Error('Nie udało się pobrać tokena formularza')}
async function stationAction(url,id,question){if(question&&!confirm(question))return;try{await ensureCsrf();await post(url,stationBody({id}));show(true,'Operacja wykonana.');await loadStations()}catch(e){show(false,e.message)}}
async function loadStations(){try{const r=await fetch('/api/v1/stations',{cache:'no-store'});if(!r.ok)throw Error('HTTP '+r.status);const d=await r.json();stationList.replaceChildren();stationEmpty.hidden=d.stations.length!==0;for(const s of d.stations){const card=document.createElement('article');card.className='card station-item';const h=document.createElement('h2'),position=document.createElement('span'),name=document.createElement('span');position.className='tag';position.textContent=String(s.position);name.textContent=s.name;h.append(position,name);if(s.isDefault){const tag=document.createElement('span');tag.className='tag ok';tag.textContent='DOMYSLNA';h.append(tag)}const url=document.createElement('p');url.className='station-url muted';url.textContent=s.url;const details=document.createElement('p');details.className='hint';details.textContent='ID '+s.id+' / trim '+s.volumeTrim;const actions=document.createElement('div');actions.className='actions';const buttons=[['Odtworz',()=>stationAction('/api/v1/stations/play',s.id)],['Edytuj',()=>{location.hash='stations';$('#stationId').value=s.id;$('#stationName').value=s.name;$('#stationUrl').value=s.url;$('#stationTrim').value=s.volumeTrim;$('#stationFormTitle').textContent='Edytuj stacje';$('#stationCancel').hidden=false;scrollTo({top:0,behavior:'smooth'})}],['Usun',()=>stationAction('/api/v1/stations/delete',s.id,'Usunac stacje?')],['Gora',()=>stationAction('/api/v1/stations/move-up',s.id)],['Dol',()=>stationAction('/api/v1/stations/move-down',s.id)],['Ustaw domyslna',()=>stationAction('/api/v1/stations/default',s.id)]];buttons.forEach(([label,action])=>{const b=document.createElement('button');b.type='button';b.textContent=label;b.onclick=action;if(label==='Usun')b.className='danger';actions.append(b)});card.append(h,url,details,actions);stationList.append(card)}}catch(e){show(false,'Nie mozna odczytac stacji: '+e.message)}}
stationForm.addEventListener('submit',async e=>{e.preventDefault();const id=$('#stationId').value,url=id?'/api/v1/stations/update':'/api/v1/stations';try{await ensureCsrf();const body=stationBody({name:$('#stationName').value,url:$('#stationUrl').value,volumeTrim:$('#stationTrim').value});if(id)body.set('id',id);await post(url,body);show(true,id?'Stacja zaktualizowana.':'Stacja dodana.');clearStationForm();await loadStations()}catch(err){show(false,err.message)}});
$('#stationCancel').onclick=clearStationForm;
window.addEventListener('hashchange',tab);tab();
async function loadConfig(){try{const r=await fetch('/api/v1/config',{cache:'no-store'});if(!r.ok)throw Error('HTTP '+r.status);const data=await r.json();csrf=data.csrf;for(const input of form.elements){if(input.name&&Object.hasOwn(data,input.name))input.value=String(data[input.name])}const root=form.elements.namedItem('mqtt.rootTopic');if(root&&data['mqtt.autoRoot'])root.placeholder=data['mqtt.autoRoot'];all('.wifi-profile-body').forEach(body=>{const input=body.querySelector('input[name$=".ssid"]'),ssid=body.parentElement.querySelector('.wifi-profile-ssid');if(input&&ssid)ssid.textContent=input.value?input.value:''});conditions()}catch(e){show(false,'Nie można odczytać konfiguracji: '+e.message)}}
async function post(url,body){const r=await fetch(url,{method:'POST',headers:{'Content-Type':'application/x-www-form-urlencoded'},body});let data;try{data=await r.json()}catch(_){throw Error('Nieprawidłowa odpowiedź serwera')}if(!r.ok||!data.ok)throw Error(data.error||'HTTP '+r.status);return data}
const restartControls=()=>[form.querySelector('button[type=submit]'),$('#reboot'),$('#clearWifi'),$('#reset')];
function lockRestartControls(disabled){restartControls().forEach(button=>{button.disabled=disabled})}
const sleep=ms=>new Promise(resolve=>setTimeout(resolve,ms));
async function restartProbe(){const controller=new AbortController(),timer=setTimeout(()=>controller.abort(),900);try{const r=await fetch('/api/v1/status?restart_probe='+Date.now(),{cache:'no-store',signal:controller.signal});return r.ok}catch(_){return false}finally{clearTimeout(timer)}}
async function waitForRestart(message){if(restartWaitActive)return;restartWaitActive=true;statusReady=false;lockRestartControls(true);show(true,message);const started=Date.now();await sleep(1800);while(restartWaitActive&&Date.now()-started<30000){if(await restartProbe()){window.location.reload();return}const remaining=30000-(Date.now()-started);if(remaining>0)await sleep(Math.min(1000,remaining))}restartWaitActive=false;statusReady=true;lockRestartControls(false);show(false,'VoxOne nie odpowiedział po restarcie. Odśwież stronę ręcznie.')}
form.addEventListener('submit',async e=>{e.preventDefault();if(restartWaitActive)return;lockRestartControls(true);try{await ensureCsrf();const body=new URLSearchParams(new FormData(form));body.set('_token',csrf);await post('/api/v1/config',body);waitForRestart('Zapisano. VoxOne uruchamia się ponownie…')}catch(err){show(false,err.message);lockRestartControls(false)}});
async function admin(url,word,code,message){if(restartWaitActive||!confirm(word))return;lockRestartControls(true);try{await ensureCsrf();await post(url,new URLSearchParams({_token:csrf,confirm:code}));waitForRestart(message)}catch(e){show(false,e.message);lockRestartControls(false)}}
$('#reboot').onclick=()=>admin('/reboot','Uruchomić VoxOne ponownie?','YES','VoxOne uruchamia się ponownie…');
$('#clearWifi').onclick=()=>admin('/wifi/clear','Usunąć zapisane Wi-Fi?','YES','Usunięto Wi-Fi. VoxOne uruchamia się ponownie…');
$('#reset').onclick=()=>admin('/api/v1/config/reset','Przywrócić ustawienia domyślne?','RESET','Przywrócono ustawienia domyślne. VoxOne uruchamia się ponownie…');
async function refreshStatus(){if(document.hidden||statusInFlight)return;statusInFlight=true;try{const r=await fetch('/api/v1/status',{cache:'no-store'});if(!r.ok)return;const d=await r.json();d.wifi_active_profile=d.wifi_active_profile<0?'-':String(d.wifi_active_profile+1)+' · '+d.wifi_active_ssid;d.wifi_last_good_profile=d.wifi_last_good_profile<0?'-':String(d.wifi_last_good_profile+1);d.wifi_status=d.wifi_connected?'Połączono':'Offline';d.wifi_rssi=d.wifi_connected?d.wifi_rssi+' dBm':'-';d.uptime_s=d.uptime_s+' s';d.free_heap=d.free_heap+' B';d.bluetooth_state=d.bluetooth_connected?(d.bluetooth_playing?'PLAYING':'CONNECTED'):'DISCONNECTED';all('[data-status]').forEach(el=>{el.textContent=d[el.dataset.status]??'-'})}catch(_){}finally{statusInFlight=false}}
configPromise=loadConfig();configPromise.then(()=>{statusReady=true;refreshStatus()});setInterval(()=>{if(statusReady&&!document.hidden)refreshStatus()},15000);document.addEventListener('visibilitychange',()=>{if(statusReady&&!document.hidden)refreshStatus()});
})();
</script></body></html>)HTML";
}
}
